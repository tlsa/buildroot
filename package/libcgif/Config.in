## package/libcgif/Config.in
```kconfig
config BR2_PACKAGE_LIBCGIF
	bool "libcgif"
	help
	  CGIF is a GIF encoder written in C.

	  https://github.com/dloebl/cgif
```

## package/libcyaml/Config.in
```kconfig
config BR2_PACKAGE_LIBCYAML
	bool "libcyaml"
	select BR2_PACKAGE_LIBYAML
	help
	  LibCYAML is a C library for reading and writing YAML.

	  https://github.com/tlsa/libcyaml
```
